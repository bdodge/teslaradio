## dts/bindings/ambiq,am08x.yaml
```yaml
#
# Copyright (c) 2021 Level Home. All rights reserved.
#

description: AM08x RTC driver

compatible: "ambiq,am08x"

include: "i2c-device.yaml"

properties:
    label:
        type: string

    int-gpios:
        type: phandle-array
        required: false
        description: |
          IRQ interrupt output pin

    exti-gpios:
        type: phandle-array
        required: false
        description: |
          External interrupt pin

    wdi-gpios:
        type: phandle-array
        required: false
        description: |
          Watchdog interrupt pin

    status:
      required: true
      type: string
      description: indicates the operational status of a device
      enum:
         - "ok"
         - "okay"
         - "disabled"
         - "reserved"
         - "fail"
         - "fail-sss"
```

## dts/bindings/issi,is31fl3296.yaml
```yaml
# Copyright (c) 2023 Endor AG
# SPDX-License-Identifier: Apache-2.0

description: |
  is31fl3296 LED driver for Lumissil Microsystems (a division of ISSI)

compatible: "issi,is31fl3296"

include: i2c-device.yaml
```

## dts/bindings/level,adc-ratio.yaml
```yaml
#
# Copyright (c) 2023 Level Home. All rights reserved.
#

description: ADC with voltage divider + enable / disable

compatible: "level,adc-ratio"

properties:
  enable-rail:
    type: phandle
    required: false
    description: |
      Power rail needed to support reading, activated by adc driver

  active-when-gpio:
    type: phandle
    required: false
    description: |
      Reading is only valid if this gpio is activated by some other means (not adc driver)

  io-channels:
    type: phandle-array
    required: true
    description: |
      ADC channel index

  full-ohms:
    type: int
    required: true
    description: |
      Resistance of the full path through the voltage divider (top + bottom resistor).

  output-ohms:
    type: int
    required: true
    description: |
      Resistance of the lower leg of the voltage divider (bottom resistor)

  sample-period-ms:
    type: int
    required: false
    description: |
      Software based timer to continuously monitor the ADC

  label:
    type: string
    required: true
    description: Human readable string describing the device (used by Zephyr for API name)

  status:
    type: string
    required: true
    description: indicates the operational status of a device
    enum:
      - "ok"
      - "okay"
      - "disabled"
      - "reserved"
      - "fail"
      - "fail-sss"
```

## dts/bindings/level,board-id.yaml
```yaml
#
# Copyright (c) 2021 Level Home. All rights reserved.
# Author: Julian Brown <julian@intercreate.io>
#

description: Board ID device for identifying HW revision

compatible: "level,board-id"

properties:
  id0-pin:
    type: phandle
    required: true
    description: |
      Pin associated with board ID 0 resistors

  id1-pin:
    type: phandle
    required: true
    description: |
      Pin associated with board ID 1 resistors

  id2-pin:
    type: phandle
    required: true
    description: |
      Pin associated with board ID 2 resistors

  id3-pin:
    type: phandle
    required: true
    description: |
      Pin associated with board ID 3 resistors

  id4-pin:
    type: phandle
    required: true
    description: |
      Pin associated with board ID 4 resistors

  label:
    type: string
    required: true
    description: Human readable string describing the device (used by Zephyr for API name)

  status:
    type: string
    required: true
    description: indicates the operational status of a device
    enum:
      - "ok"
      - "okay"
      - "disabled"
      - "reserved"
      - "fail"
      - "fail-sss"
```

## dts/bindings/level,gpio-out.yaml
```yaml
description: Generic GPIO configuration

compatible: "level,gpio-out"

properties:
   gpios:
      type: phandle-array
      required: true
   label:
      required: true
      type: string
      description: Human readable string describing the device (used by Zephyr for API name)
   status:
      required: true
      type: string
      description: indicates the operational status of a device
      enum:
         - "okay"
         - "disabled"
         - "reserved"
         - "fail"
         - "fail-sss"
```

## dts/bindings/level,gpios.yaml
```yaml
#
# Copyright (c) 2021 Intimuse. All rights reserved.
# Author: Rob Helvestine <rob@intercreate.io>
#

description: Generic GPIO configuration for multiple gpios

compatible: "level,gpios"

child-binding:
  description: Child definition
  properties:
     gpios:
        type: phandle-array
        required: true
     label:
        required: true
        type: string
        description: Human readable string describing the device (used by Zephyr for API name)
```

## dts/bindings/level,h-bridge.yaml
```yaml
#
# Copyright (c) 2021 Level Home. All rights reserved.
# Author: Julian Brown <julian@intercreate.io>
#

description: Generic H-bridge driver

compatible: "level,h-bridge"

properties:
  enable-gpiopin:
    type: phandle
    required: false
    description: |
      GPIO pin used to enable/disable H-bridge

  pwm-channel:
    type: phandle
    required: true
    description: |
      PWM device object used to drive motor

  forward-pin:
    type: int
    required: true
    description: |
      Pin number used for forward channel

  reverse-pin:
    type: int
    required: false
    description: |
      Pin number used for reverse channel
      
  label:
    type: string
    required: true
    description: Human readable string describing the device (used by Zephyr for API name)

  status:
    required: true
    type: string
    description: indicates the operational status of a device
    enum:
      - "okay"
      - "disabled"
      - "reserved"
      - "fail"
      - "fail-sss"
```

## dts/bindings/level,motor-controller.yaml
```yaml
#
# Copyright (c) 2021 Level Home. All rights reserved.
# Author: Julian Brown <julian@intercreate.io>
#

description: PID-based motor controller device

compatible: "level,motor-controller"

properties:
  motor-driver:
    type: phandle
    required: true
    description: |
      Motor driver device used to control motor in question

  position-sensor:
    type: phandle
    required: true
    description: |
      Position sensor used to determine motor position

  k-p:
    type: int
    required: true
    description: |
      Proportional gain of PID system

  k-i:
    type: int
    required: true
    description: |
      Integral gain of PID system

  k-d:
    type: int
    required: true
    description: |
      Derivative gain of PID system

  label:
    type: string
    required: true
    description: Human readable string describing the device (used by Zephyr for API name)

  status:
    type: string
    required: true
    description: indicates the operational status of a device
    enum:
      - "ok"
      - "okay"
      - "disabled"
      - "reserved"
      - "fail"
      - "fail-sss"
```

## dts/bindings/level,nfc.yaml
```yaml
#
# Copyright (c) 2023 Level Home. All rights reserved.
#

description: NFC SPI3 device

compatible: "level,nfc"

properties:
    label:
        type: string
        required: true
    sck_gpios:
        type: phandle-array
        required: true
    miso_gpios:
        type: phandle-array
        required: true
    mosi_gpios:
        type: phandle-array
        required: true
    ss_gpios:
        type: phandle-array
        required: true
```

## dts/bindings/level,nrf-compgpioteppi.yaml
```yaml
#
# Copyright (c) 2022 Level Home. All rights reserved.
#

include: base.yaml

description: A very specific driver that triggers a GPIO output based on an COMP event

compatible: "level,nrf-compgpioteppi"

properties:
  comp-event:
    type: int
    required: true
    description: |
      The triggering event. Can be compare READY, DOWN, UP, DOWN, CROSS

  comp-vref:
    type: int
    required: true
    description: |
      The voltage reference. 1.2V, 1.8V, or 2.4V

  gpio-pin:
    type: phandle
    required: true
    description: GPIO which change state upon event.

  gpiote-task:
    type: int
    required: true
    description: The task to run upon the event. Can be LOW, HIGH, or TOGGLE

  adcchan:
    type: phandle
    required: true
    description: The adc channel used for the compare
```

## dts/bindings/level,power-rail.yaml
```yaml
#
# Copyright (c) 2021 Level Home. All rights reserved.
#

description: Generic Power Rail Control

compatible: "level,power-rail"

properties:
    enable-pin:
        type: phandle
        required: true
        description: |
          The pin that controls power rail enable

    dependency:
        type: phandle
        required: false
        description: |
          Power rail that this rail requires to function

    startup-delay-ms:
        type: int
        required: true

    default-on:
        type: boolean
        required: false

    active-low:
        type: boolean
        required: false

    label:
        type: string
        required: true

    status:
        type: string
        required: false
        description: indicates the operational status of a device
        enum:
           - "okay"
           - "disabled"
           - "reserved"
           - "fail"
           - "fail-sss"
```

## dts/bindings/memsic,mmc5603.yaml
```yaml
#
# Copyright (c) 2023 Level Home. All rights reserved.
#

include: sensor-device.yaml

description: |
    Memsic MMC5603 magnetometer accessed through I2C bus

compatible: "memsic,mmc5603"

include: ["i2c-device.yaml"]

properties:
  auto-set-reset:
    type: boolean
    description: |
      Set to enable S/R mode to cancel internal magnetization.
      See data sheet. Disabled as default.

  sample-freq:
    type: int
    description: |
      Take samples continuously at this rate (Hz) from 1 to 50. 0 is default
      and means single-shot mode only

  bandwidth:
    type: int
    description: |
      Bandwidth setting 0-3. See data sheet. default is 0

  use_20_bits:
    type: boolean
    description: |
      If true, Get 20 bits (not 16) of measurement data (experimental) default false

  saturation_interval:
    type: int
    description: |
      The number of samples taken between checking for saturation. default of 0 means
      never check for saturation
```

## dts/bindings/st,lis2dw12-level.yaml
```yaml
description: LIS2DW12 accel driver

compatible: "st,lis2dw12-level"

include: i2c-device.yaml

properties:
  irq-pin:
    type: phandle
    required: false
    description: |
      DRDY pin

      This pin defaults to active high when produced by the sensor.
      The property value should ensure the flags properly describe
      the signal that is presented to the driver.

  label:
      type: string
      description: Human readable string describing the device (used by Zephyr for API name)

  status:
      required: true
      type: string
      description: indicates the operational status of a device
      enum:
         - "ok"
         - "okay"
         - "disabled"
         - "reserved"
         - "fail"
         - "fail-sss"
```

## dts/bindings/ti,tas2555.yaml
```yaml
#
# Copyright (c) 2021 Level Home. All rights reserved.
# Author: Julian Brown <julian@intercreate.io>
#

description: TAS2555 codec driver

compatible: "ti,tas2555"

include: i2c-device.yaml

properties:
  i2s-channel:
      type: phandle
      required: true
      description: |
          I2S bus

  reset-gpio:
      type: phandle
      required: false

  power-rail:
      type: phandle
      required: true

  label:
      type: string
      description: Human readable string describing the device (used by Zephyr for API name)

  status:
      required: true
      type: string
      description: indicates the operational status of a device
      enum:
         - "ok"
         - "okay"
         - "disabled"
         - "reserved"
         - "fail"
         - "fail-sss"
```
